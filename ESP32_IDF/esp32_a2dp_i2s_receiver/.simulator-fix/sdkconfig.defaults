## ESP32_IDF/esp32_a2dp_i2s_receiver/.simulator-fix/sdkconfig.defaults
```kconfig
CONFIG_IDF_TARGET="esp32"
CONFIG_ESP_DEFAULT_CPU_FREQ_MHZ_160=y
CONFIG_ESP_DEFAULT_CPU_FREQ_MHZ=160
CONFIG_ESP_CONSOLE_UART_BAUDRATE=115200
```
